## boards/shields/nrf-ble-dongle/Kconfig.shield
```kconfig
# No whitespace after the comma or in the keyboard name!
config SHIELD_NRF_BLE_DONGLE
    def_bool $(shields_list_contains,nrf_ble_dongle_dongle)
```
